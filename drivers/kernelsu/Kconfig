## drivers/kernelsu/Kconfig
```kconfig
menu "KernelSU"

config KSU
	tristate "KernelSU module"
	default y
	select OVERLAY_FS
	help
	This is the KSU privilege driver for android system.

config KSU_DEBUG
	bool "KernelSU module debug mode"
	depends on KSU
	default n
	help
	This enables debug mode for KSU

endmenu
```
